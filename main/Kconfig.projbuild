## main/Kconfig.projbuild
```kconfig
menu "BME280 configuration"
    choice BME280_I2C_ADDRESS
        prompt "Select I2C address"
        help
            Select I2C address.

        config BME280_I2C_ADDRESS_0
            bool "BME680_I2C_ADDR_0 (0x76)"
        config BME280_I2C_ADDRESS_1
            bool "BME680_I2C_ADDR_1 (0x77)"
    endchoice

    config I2C_MASTER_SCL
        int "SCL GPIO Number"
        default 5
        help
            GPIO number for I2C Master clock line.
        
    config I2C_MASTER_SDA
        int "SDA GPIO Number"
        default 4
        help
            GPIO number for I2C Master data line.

endmenu

menu "BH1750 configuration"
    choice BH1750_ADDRESS
        prompt "Select I2C address"
        default BH1750_I2C_ADDRESS_LO
        help
            Select I2C address

        config BH1750_I2C_ADDRESS_LO
            bool "BH1750_ADDR_LO"
            help
                Choose this when ADDR pin is floating or low.
        config BH1750_I2C_ADDRESS_HI
            bool "BH1750_ADDR_HI"
            help
                Choose this when ADDR pin is high.
    endchoice
endmenu

menu "WiFi configuration"
    config WIFI_SSID
        string "enter wifi ssid"
    config WIFI_PASSWORD
        string "enter wifi password"
endmenu

menu "MQTT configuration"
    config BROKER_URI
        default "mqtt://mqtt.eclipse.org:1883"
        string "enter broker uri"
    config MQTT_USERNAME
        string "enter mqtt username"
    config MQTT_PASSWORD
        string "enter mqtt password"
endmenu

config MEASUREMENT_INTERVAL
    int "Define sensor measurement interval"
    default 10000
```

## sdkconfig.defaults
```kconfig
# 
# Defaults set to free chip heap memory
#

CONFIG_MBEDTLS_DYNAMIC_BUFFER=y
CONFIG_MBEDTLS_DYNAMIC_FREE_PEER_CERT=y
CONFIG_MBEDTLS_DYNAMIC_FREE_CONFIG_DATA=y

CONFIG_MBEDTLS_SSL_PROTO_SSL3=n
CONFIG_MBEDTLS_SSL_PROTO_TLS1=n
CONFIG_MBEDTLS_SSL_PROTO_TLS1_1=n
CONFIG_MBEDTLS_TLS_SERVER_ONLY=n
```
